## packages/cogeno/cogeno-0.2.2-py3-none-any.whl/cogeno/modules/edtsdb/dts/bindings/gpio-controller.yaml
```yaml
# Copyright (c) 2019, Linaro Limited
# Copyright (c) 2019..2020 Bobby Noelte
# SPDX-License-Identifier: Apache-2.0

# Common fields for GPIO controllers

include: base.yaml

properties:
    "gpio-controller":
      type: boolean
      required: true
      description: Convey's this node is a GPIO controller

    "#gpio-cells":
      type: int
      required: true
      description: Number of items to expect in a GPIO specifier

    ngpios:
      type: int
      required: false
      description: Number of gpios supported

    gpio-ranges:
      type: phandle-array
      required: false
      description: gpio range in pin controller

    gpio-ranges-group-names:
      type: string-array
      required: false
      description: gpio range names

gpio-cells:
  - pin
  - flags
```

## packages/cogeno/cogeno-0.2.2-py3-none-any.whl/cogeno/modules/edtsdb/dts/bindings/pwm-client.yaml
```yaml
#
# Copyright (c) 2018..2020 Bobby Noelte
#
# SPDX-License-Identifier: Apache-2.0
#

description: PWM Client

properties:
    pwms:
      type: phandle-array
      required: true
      description: >
        List of phandle and pwm specifiers, one set for each pwm
        input to the device. Note - The number of pwm specifiers is
        determined by the dma-cells property in the node referenced by phandle

    pwm-names:
      type: string-array
      required: false
      description: >
        List of strings to label each of the PWM devices sorted in the same
        order as the pwms property.
```

## packages/cogeno/cogeno-0.2.2-py3-none-any.whl/cogeno/modules/edtsdb/dts/bindings/pwm-controller.yaml
```yaml
# Copyright (c) 2017, NXP
# Copyright (c) 2019 Bobby Noelte
#
# SPDX-License-Identifier: Apache-2.0

# Common fields for PWM controllers

include: base.yaml

properties:
    label:
      required: true

    "#pwm-cells":
      type: int
      required: true
      description: Number of items to expect in a pwm specifier

    clocks:
      required: false
```

## packages/cogeno/cogeno-0.2.2-py3-none-any.whl/cogeno/modules/edtsdb/dts/bindings/reserved-memory.yaml
```yaml
# Copyright (c) 2020 Bobby Noeltw
# SPDX-License-Identifier: Apache-2.0

# Common fields for reserved memory

description: Reserved memory properties

compatible: "reserved-memory"

include: base.yaml

properties:
    ranges:
      type: boolean
      required: true
      description: standard definition
```

## packages/cogeno/cogeno-0.2.2.tar.gz/cogeno-0.2.2/cogeno/modules/edtsdb/dts/bindings/chosen.yaml
```yaml
# Copyright (c) 2019..2020 Bobby Noelte
# SPDX-License-Identifier: Apache-2.0

description: Chosen properties

compatible: "chosen"

properties:
    stdout-path:
        type: string
        required: false
        description: >
          Device to be used for boot console output
          If the character ":" is present in the value, this terminates the path.
          The meaning of any characters following the ":" is device-specific, and
          must be specified in the relevant binding documentation.
          For UART devices, the preferred binding is a string in the form:
            path:<baud>{<parity>{<bits>{<flow>}}}
          where
            path    - path of uart device
            baud	- baud rate in decimal
            parity	- 'n' (none), 'o', (odd) or 'e' (even)
            bits	- number of data bits
            flow	- 'r' (rts)
          For example: 115200n8r

    zephyr,entropy:
        type: path
        required: false
        description: A device which can be used as a system-wide entropy source.

    zephyr,flash:
        type: path
        required: false
        description: >
          A node whose reg is sometimes used to set the defaults for CONFIG_FLASH_BASE_ADDRESS
          and CONFIG_FLASH_SIZE.

    zephyr,sram:
        type: path
        required: false
        description: >
          A node whose reg sets the base address and size of SRAM memory available to the Zephyr
          image, used during linking.

    zephyr,ccm:
        type: path
        required: false
        description: TBD

    zephyr,console:
        type: path
        required: false
        description: TBD

    zephyr,shell-uart:
        type: path
        required: false
        description: TBD

    zephyr,bt-uart:
        type: path
        required: false
        description: TBD

    zephyr,uart-pipe:
        type: path
        required: false
        description: TBD

    zephyr,bt-mon-uart:
        type: path
        required: false
        description: TBD

    zephyr,uart-mcumgr:
        type: path
        required: false
        description: TBD
```

## packages/cogeno/cogeno-0.2.2.tar.gz/cogeno-0.2.2/cogeno/modules/edtsdb/dts/bindings/fixed-clock.yaml
```yaml
#
# Copyright (c) 2017..2019 b0661n0e17e@gmail.com
#
# SPDX-License-Identifier: Apache-2.0
#

title: Simple fixed-rate clock sources.

description: >
    Binding for simple fixed-rate clock sources.

inherits:
    !include clock-provider.yaml

properties:
    compatible:
      constraint: "fixed-clock"

    "#clock-cells":
      constraint: 0

    clock-frequency:
      type: int
      category: required
      description: Frequency of clock in Hz. Should be a single cell.

    clock-accuracy:
      type: int
      category: optional
      description: Accuracy of clock in ppb (parts per billion). Should be a single cell.

    oscillator:
      type: int
      category: optional
      description: clock is an oszillator (a quartz)
```

## packages/cogeno/cogeno-0.2.2.tar.gz/cogeno-0.2.2/cogeno/modules/edtsdb/dts/bindings/flash.yaml
```yaml
# Copyright (c) 2018..2020 Bobby Noelte
# SPDX-License-Identifier: Apache-2.0

description: Flash Base Structure

include: base.yaml

properties:
    label:
      required: true

    reg:
      required: true

    "#address-cells":
      type: int
      required: true
      description: >
        <1>: for flash devices that require a single 32-bit cell to represent their
            address (aka the value is below 4 GiB)
        <2>: for flash devices that require two 32-bit cells to represent their
            address (aka the value is 4 GiB or greater).

    "#size-cells":
      type: int
      required: true
      description: >
        <1>: for flash devices that require a single 32-bit cell to represent their
            size (aka the value is below 4 GiB)
        <2>: for flash devices that require two 32-bit cells to represent their
            size (aka the value is 4 GiB or greater).

    write-block-size:
      type: int
      required: false
      description: Size of flash blocks  for write operations

    erase-block-size:
      type: int
      required: false
      description: Size of flash blocks for erase operations
```

## packages/cogeno/cogeno-0.2.2.tar.gz/cogeno-0.2.2/cogeno/modules/edtsdb/dts/bindings/gpio-leds.yaml
```yaml
# Copyright (c) 2018, Linaro Limited
# Copyright (c) 2020 Bobby Noelte
# SPDX-License-Identifier: Apache-2.0

description: GPIO LEDs controller

compatible: "gpio-leds"

include: base.yaml

properties:
       label:
          default: "GPIO_LEDS"
```

## packages/cogeno/cogeno-0.2.2.tar.gz/cogeno-0.2.2/cogeno/modules/edtsdb/dts/bindings/memory-region.yaml
```yaml
# Copyright (c) 2020 Bobby Noeltw
# SPDX-License-Identifier: Apache-2.0

# Common fields for memory regions

description: Memory region properties

compatible: "memory-region"

include: base.yaml

properties:
    reg:
      required: true

    label:
      required: false
```

## packages/cogeno/cogeno-0.2.2.tar.gz/cogeno-0.2.2/cogeno/modules/edtsdb/dts/bindings/memory.yaml
```yaml
# Copyright (c) 2020 Bobby Noeltw
# SPDX-License-Identifier: Apache-2.0

# Common fields for memory

description: Memory properties

compatible: "memory"

include: base.yaml

properties:
    reg:
      required: true
```

## packages/cogeno/cogeno-0.2.2.tar.gz/cogeno-0.2.2/cogeno/modules/edtsdb/dts/bindings/pin-controller.yaml
```yaml
# Copyright (c) 2018..2020 Bobby Noelte
# SPDX-License-Identifier: Apache-2.0

description: Pin controller

include: base.yaml

properties:
    pin-controller:
      type: boolean
      required: true
      description: device controller identification

    "#pinctrl-cells":
      type: int
      required: false
      description: >
        Number of pin control cells in addition to the index within the
        pin controller device instance
```

## packages/cogeno/cogeno-0.2.2.tar.gz/cogeno-0.2.2/cogeno/modules/edtsdb/dts/bindings/reserved-memory-region.yaml
```yaml
# Copyright (c) 2020 Bobby Noeltw
# SPDX-License-Identifier: Apache-2.0

# Common fields for reserved memory regions

description: Reserved memory region properties

compatible: "reserved-memory-region"

include: base.yaml

properties:
    reg:
      required: false

    size:
      type: int
      required: false
      description: >
        length based on parent's #size-cells
        Size in bytes of memory to reserve.

    alignment:
      type: int
      required: false
      description: >
        length based on parent's #size-cells
        Address boundary for alignment of allocation.

    alloc-ranges:
      type: array
      required: false
      description: >
        prop-encoded-array (address, length pairs).
        Specifies regions of memory that are
        acceptable to allocate from.
```
